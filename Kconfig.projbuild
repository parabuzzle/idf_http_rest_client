## Kconfig.projbuild
```kconfig
menu "HTTP REST Client"

  config HTTP_REST_CLIENT_MAX_RECEIVE_BUFFER
    int "Max receive buffer"
    default 1024
    help
      This is the maximum size of the receive buffer for HTTP REST client.

  config HTTP_REST_CLIENT_MAX_SEND_BUFFER
    int "Max send buffer"
    default 1024
    help
      This is the maximum size of the send buffer for HTTP REST client.

endmenu
```

## dist/http_rest_client_0.1.1/Kconfig.projbuild
```kconfig
menu "HTTP REST Client"

  config HTTP_REST_CLIENT_USER_AGENT
    string "User Agent"
    default "IDF HTTP REST Client/1.0"
    help
      This is the User Agent string to be used by the client.

endmenu
```
